## kernel-3.0.8/arch/mips/xburst/soc-4780/Kconfig
```kconfig
choice
	prompt "Chip type"
	depends on SOC_4780
	default CHIP_4780

config CHIP_4780
       bool "chip-4780"
       select TRACEPOINTS
       select SYS_SUPPORTS_HIGHMEM
       select GENERIC_CLOCKEVENTS_BROADCAST

endchoice

if CHIP_4780
source "arch/mips/xburst/soc-4780/chip-4780/Kconfig"
endif
```

## kernel-3.0.8/arch/mips/xburst/soc-m200/chip-m200/Kconfig
```kconfig
choice
	prompt "Board type"
	depends on CHIP_M200
	default PRODUCT_DEVELOP

config BOARD_4785_FPGA
       bool "FPGA"

config PRODUCT_DEVELOP
       bool "DEVELOP"

config PRODUCT_RVMS
       bool "RVMS"

endchoice

config PRODUCT_NAME
	string
	default "fpga" if BOARD_4785_FPGA
	default "dorado" if PRODUCT_DEVELOP
	default "rvms" if PRODUCT_RVMS

if PRODUCT_DEVELOP
source "arch/mips/xburst/soc-m200/chip-m200/dorado/Kconfig"
endif

if PRODUCT_RVMS
source "arch/mips/xburst/soc-m200/chip-m200/rvms/Kconfig"
endif
```

## kernel-3.0.8/arch/mips/xburst/soc-m200/chip-m200/rvms/Kconfig
```kconfig
choice
	prompt "BOARD type"
	depends on PRODUCT_RVMS
	default BOARD_FORNAX

config BOARD_FORNAX
       bool "board fornax"
       depends on PRODUCT_RVMS
config BOARD_PAWSCAN
       bool "board pawscan"
       depends on PRODUCT_RVMS
config BOARD_DOORBELL
       bool "board doorbell"
       depends on PRODUCT_RVMS
endchoice

config BOARD_NAME
	string
	default "fornax" if BOARD_FORNAX
	default "NP_PawScam01m_AB" if BOARD_PAWSCAN
	default "doorbell" if BOARD_DOORBELL
```

## kernel-3.0.8/arch/mips/xburst/soc-x1000/chip-x1000/Kconfig
```kconfig
choice
	prompt "Board type"
	depends on SOC_X1000
	default PRODUCT_X1000_PHOENIX

config  PRODUCT_X1000_PHOENIX
    bool "product x1000 phoenix"

config  PRODUCT_X1000_CANNA
    bool "product x1000 canna"

config  PRODUCT_X1000_ASLMOM
    bool "product x1000 aslmom"

config  PRODUCT_X1000_YOUTH
    bool "product x1000 youth"

config  PRODUCT_X1000_HL01
    bool "product x1000 hl01"

config  PRODUCT_X1000_SF_AUD_HM02W01
    bool "product x1000 sf_aud_hm02w01"

config  PRODUCT_X1000_HALLEY2
        bool "product x1000 halley2"

config  PRODUCT_X1000_PANSY
        bool "product x1000 pansy"
endchoice

if PRODUCT_X1000_PHOENIX
config PRODUCT_NAME
string
default "phoenix"
source "arch/mips/xburst/soc-x1000/chip-x1000/phoenix/Kconfig"
endif

if PRODUCT_X1000_CANNA
config PRODUCT_NAME
string
default "canna"
source "arch/mips/xburst/soc-x1000/chip-x1000/canna/Kconfig"
endif

if PRODUCT_X1000_ASLMOM
config PRODUCT_NAME
string
default "aslmom"
source "arch/mips/xburst/soc-x1000/chip-x1000/aslmom/Kconfig"
endif

if PRODUCT_X1000_YOUTH
config PRODUCT_NAME
string
default "youth"
source "arch/mips/xburst/soc-x1000/chip-x1000/youth/Kconfig"
endif

if PRODUCT_X1000_HL01
config PRODUCT_NAME
string
default "hl01"
source "arch/mips/xburst/soc-x1000/chip-x1000/hl01/Kconfig"
endif

if PRODUCT_X1000_SF_AUD_HM02W01
config PRODUCT_NAME
string
default "sf_aud_hm02w01"
source "arch/mips/xburst/soc-x1000/chip-x1000/sf_aud_hm02w01/Kconfig"
endif

if PRODUCT_X1000_HALLEY2
config PRODUCT_NAME
string
default "halley2"
source "arch/mips/xburst/soc-x1000/chip-x1000/halley2/Kconfig"
endif

if PRODUCT_X1000_PANSY
config PRODUCT_NAME
string
default "pansy"
source "arch/mips/xburst/soc-x1000/chip-x1000/pansy/Kconfig"
endif
```

## kernel-3.0.8/arch/mips/xburst/soc-x1000/chip-x1000/aslmom/Kconfig
```kconfig
choice
prompt "BOARD version"
depends on PRODUCT_X1000_ASLMOM
default BOARD_X1000_ASLMOM_V10

config BOARD_X1000_ASLMOM_V10
bool "board x1000 aslmom v10"
depends on PRODUCT_X1000_ASLMOM

endchoice

config BOARD_NAME
string
default "aslmom_v10" if BOARD_X1000_ASLMOM_V10
```

## kernel-3.0.8/arch/mips/xburst/soc-x1000/chip-x1000/canna/Kconfig
```kconfig
choice
prompt "BOARD version"
depends on PRODUCT_X1000_CANNA
default BOARD_X1000_CANNA_V10

config BOARD_X1000_CANNA_V10
bool "board x1000 canna v10"
depends on PRODUCT_X1000_CANNA

config BOARD_X1000_CANNA_V22
bool "board x1000 canna v22"
depends on PRODUCT_X1000_CANNA

config BOARD_X1000_CANNA_V23
bool "board x1000 canna v23"
depends on PRODUCT_X1000_CANNA


endchoice

config BOARD_NAME
string
default "canna_v10" if BOARD_X1000_CANNA_V10

config BOARD_NAME
string
default "canna_v22" if BOARD_X1000_CANNA_V22

config BOARD_NAME
string
default "canna_v23" if BOARD_X1000_CANNA_V23
```

## kernel-3.0.8/arch/mips/xburst/soc-x1000/chip-x1000/halley2/Kconfig
```kconfig
choice
prompt "BOARD version"
depends on PRODUCT_X1000_HALLEY2
default BOARD_X1000_HALLEY2_V10

config BOARD_X1000_HALLEY2_V10
bool "board x1000 halley2 v10"
depends on PRODUCT_X1000_HALLEY2

endchoice

config BOARD_NAME
string
default "halley2_v10" if BOARD_X1000_HALLEY2_V10
```

## kernel-3.0.8/arch/mips/xburst/soc-x1000/chip-x1000/hl01/Kconfig
```kconfig
choice
prompt "BOARD version"
depends on PRODUCT_X1000_HL01
default BOARD_X1000_HL01_V10

config BOARD_X1000_HL01_V10
bool "board x1000 hl01 v10"
depends on PRODUCT_X1000_HL01

endchoice

config BOARD_NAME
string
default "hl01_v10" if BOARD_X1000_HL01_V10
```

## kernel-3.0.8/arch/mips/xburst/soc-x1000/chip-x1000/pansy/Kconfig
```kconfig
choice
prompt "BOARD version"
depends on PRODUCT_X1000_PANSY
default BOARD_X1000_PANSY_V10

config BOARD_X1000_PANSY_V10
bool "board x1000 pansy v10"
depends on PRODUCT_X1000_PANSY

endchoice

config BOARD_NAME
string
default "pansy_v10" if BOARD_X1000_PANSY_V10
```

## kernel-3.0.8/arch/mips/xburst/soc-x1000/chip-x1000/phoenix/Kconfig
```kconfig
choice
prompt "BOARD version"
depends on PRODUCT_X1000_PHOENIX
default BOARD_X1000_PHOENIX_V10

config BOARD_X1000_PHOENIX_V10
bool "board x1000 phoenix v10"
depends on PRODUCT_X1000_PHOENIX

endchoice

config BOARD_NAME
string
default "phoenix_v10" if BOARD_X1000_PHOENIX_V10
```

## kernel-3.0.8/arch/mips/xburst/soc-x1000/chip-x1000/sf_aud_hm02w01/Kconfig
```kconfig
choice
prompt "BOARD version"
depends on PRODUCT_X1000_SF_AUD_HM02W01
default BOARD_X1000_SF_AUD_HM02W01_V10

config BOARD_X1000_SF_AUD_HM02W01_V10
bool "board x1000 sf_aud_hm02w01 v10"
depends on PRODUCT_X1000_SF_AUD_HM02W01

endchoice

config BOARD_NAME
string
default "sf_aud_hm02w01_v10" if BOARD_X1000_SF_AUD_HM02W01_V10
```

## kernel-3.0.8/arch/mips/xburst/soc-x1000/chip-x1000/youth/Kconfig
```kconfig
choice
prompt "BOARD version"
depends on PRODUCT_X1000_YOUTH
default BOARD_X1000_YOUTH_V10

config BOARD_X1000_YOUTH_V10
bool "board x1000 youth v10"
depends on PRODUCT_X1000_YOUTH

endchoice

config BOARD_NAME
string
default "youth_v10" if BOARD_X1000_YOUTH_V10
```

## kernel-3.0.8/drivers/i2c/chips/Kconfig
```kconfig
#
# Miscellaneous I2C chip drivers configuration
#
# *** DEPRECATED! Do not add new entries! See Makefile ***
#

menu "Miscellaneous I2C Chip support"

config SENSORS_NEW
	tristate "use the new sensors hardware.the driver should provide  manys interface for the andriod"
	depends on EXPERIMENTAL
	help
		this is make the driver used for the andriod sensors.
config GSENSOR
	tristate "G sensor  support"
	help

config SENSORS_LIS3DH
	tristate "g_sensor LIS3DH driver"
	depends on GSENSOR
	help

config SENSORS_DMARD06
	tristate "g_sensor DMARD06 driver"
	depends on GSENSOR
	help

config SENSORS_MMA8452
        tristate "g_sensor MMA8452 driver"
        depends on GSENSOR
        help

config SENSORS_MC32X0
        tristate "g_sensor MC32X0 driver"
        depends on GSENSOR
        help

config SENSORS_BMA250E
	bool "BOSCH BMA250E triaxial accerleration sensor"
	depends on GSENSOR
	help

config SENSORS_EM7180
	bool "EM7180 sensor"
	depends on GSENSOR
	help

config SENSORS_ORI
	tristate "g_sensor orientation driver"
	depends on GSENSOR 
	default y

config LSENSOR
	tristate "L sensor  support"
	help
	
config SENSORS_STK220X
	tristate "l_sensor stk220x driver"
	depends on LSENSOR
	help

source drivers/i2c/chips/gsensor_bma223/Kconfig
endmenu
```

## kernel-3.0.8/drivers/misc/jz_cim/Kconfig
```kconfig
config JZ_CIM
	bool "ingenic camera interface module"
	depends on MACH_XBURST
	default n

config JZ_CIM0
	bool "Using Jz CIM Controller 0"
	depends on JZ_CIM && SOC_4775
	default n

config JZ_CIM1
	bool "Using Jz CIM Controller 1"
	depends on JZ_CIM && SOC_4775
	default n

config CAMERA_SENSOR_NO_MCLK_CTL
	bool "no mclk for camera sensor"
	depends on JZ_CIM
	default n

config CAMERA_SENSOR_NO_POWER_CTL
	bool "no power control pin for camera sensor"
	depends on JZ_CIM
	default n

config OV3640
	bool "ov3640 camera sensor"
	depends on JZ_CIM
	default n

config OV7675
	bool "ov7675 camera sensor"
	depends on JZ_CIM
	default n

config OV2650
	bool "ov2650 camera sensor"
	depends on JZ_CIM
	default n

config OV2659_MODULE
	bool "ov2659 camera sensor module"
	depends on JZ_CIM
	default n

config OV5640
	bool "ov5640 camera sensor module"
	depends on JZ_CIM
	default n

config OV5640_RAW_BAYER
	bool "ov5640 raw bayer mode"
	depends on JZ_CIM && OV5640
	default n

config SP0838
	bool "sp0838 camera sensor"
	depends on JZ_CIM
	default n

config ADV7180
       bool "adv7180 camera sensor"
       depends on JZ_CIM
       default n

config GC0308
	bool "gc0308 camera sensor"
	depends on JZ_CIM
	default n

config HORIZONTAL_MIRROR
	bool "camera sensor horizontal mirror"
	depends on JZ_CIM
	default n

config VERTICAL_MIRROR
	bool "camera sensor vertical mirror"
	depends on JZ_CIM
	default n

config GC0308_Q8
	bool "double_gc0308_q8 camera sensor"
	depends on JZ_CIM
	default n



config GC2015
	bool "gc2015 camera sensor"
	depends on JZ_CIM
	default n
config HI253
	bool "hi253 camera sensor"
	depends on JZ_CIM
	default n

config HI704
	bool "hi704 camera sensor"
	depends on JZ_CIM
	default n

config FAKE
	bool "fake camera sensor only for test"
	depends on JZ_CIM
	default n

config FAKE_NR
	int "fake camera sensor number"
	depends on FAKE
	default 2

config GT2005
        bool "gt2005 camera sensor"
        depends on JZ_CIM
        default n

config TVP5150
        bool "tvp5150  Texas Instruments video decoder"
        depends on JZ_CIM
        default n

config GC0307
        bool "gc0307  Galaxycore camer sensor"
        depends on JZ_CIM
        default n
```

## kernel-3.0.8/drivers/mtd/tests/Kconfig
```kconfig
menuconfig MTD_TESTS
	tristate "MTD tests support (DANGEROUS)"
	help
	  This option includes various MTD tests into compilation. The tests
	  should normally be compiled as kernel modules. The modules perform
	  various checks and verifications when loaded.

	  WARNING: some of the tests will ERASE entire MTD device which they
	  test. Do not use these tests unless you really know what you do.
	  
	  
if MTD_TESTS

config MTD_OOB_TEST
	tristate "MTD_OOB_TEST"
	help
		nothing

config MTD_PAGE_TEST
	tristate "MTD_OOB_TEST"
	help
		nothing

config MTD_READ_TEST
	tristate "MTD_READ_TEST"
	help
		nothing

config MTD_SPEED_TEST
	tristate "MTD_SPEED_TEST"
	help
		nothing

config MTD_STRESS_TEST
	tristate "MTD_STRESS_TEST"
	help
		nothing
		
config MTD_SUBPAGE_TEST
	tristate "MTD_SUBPAGE_TEST"
	help
		nothing
	
config MTD_TORTURE_TEST
	tristate "MTD_TORTURE_TEST"
	help
		nothing

config MTD_NAND_ECC_TEST
	tristate "MTD_NAND_ECC_TEST"
	help
		nothing

config MTD_NAND_BIT_ERRS_TEST
	tristate "MTD_NAND_BIT_ERRS_TEST"
	help
		nothing

endif # MTD_TESTS
```

## kernel-3.0.8/drivers/net/wireless/mrvl8766/Kconfig
```kconfig
config MRVL8766
    tristate "Marvell MRVL8766 USB WiFi & BT "
    depends on USB
    select WIRELESS_EXT
    select WEXT_PRIV
    ---help---
    Help message of Marvell MRVL8766 wifi & BT
```

## kernel-3.0.8/drivers/nfc/Kconfig
```kconfig
#
# Near Field Communication (NFC) devices
#

menuconfig NFC_DEVICES
	bool "Near Field Communication (NFC) devices"
	default n
	---help---
	  You'll have to say Y if your computer contains an NFC device that
	  you want to use under Linux.

	  You can say N here if you don't have any Near Field Communication
	  devices connected to your computer.

if NFC_DEVICES
config BCM2079X_NFC
        tristate "BCM2079X NFC driver"
        depends on I2C
        select CRC_CCITT
        default n
        ---help---
          Say yes if you want BCM2079X Near Field Communication driver.
          This is for i2c connected version. If unsure, say N here.
          To compile this driver as a module, choose m here. The module will
          be called bcm2079x.

config BCM2079X_NFC_I2C_BUSNUM
	int "BCM2079x NFC i2c bus number"
	depends on BCM2079X_NFC
	default 0
	help
	    The bcm2079x nfc uses which one i2c controller, you must check the schematic.
config PN544_NFC
	tristate "PN544 NFC driver"
	depends on I2C
	select CRC_CCITT
	default n
	---help---
	  Say yes if you want PN544 Near Field Communication driver.
	  This is for i2c connected version. If unsure, say N here.

	  To compile this driver as a module, choose m here. The module will
	  be called pn544.


endif # NFC_DEVICES
```

## kernel-3.0.8/drivers/usb/dwc/Kconfig
```kconfig
config USB_DWC_OTG
	tristate 'Synopsys otg 2.0 support'
	depends on SOC_4780 || SOC_4775
	select DWC_LM_INTERFACE
	help
	  Say Y here to select Synopsys otg.

config DISABLE_PHY
	depends on USB_DWC_OTG
	bool "Disable PHY when USB is disconnected"
	default y
	help
	  Disable PHY when USB is disconnected.

choice
	prompt "Synopsys otg mode"
	depends on USB_DWC_OTG

config USB_DWC_OTG_DUAL
	bool "both host and device function"
	select USB_DWC_PERIPHERAL

config USB_DWC_DEV_ONLY
	bool "device function"
	select USB_DWC_PERIPHERAL

config USB_DWC_HOST_ONLY
	bool "host function"

endchoice

config USB_DWC_PERIPHERAL
	bool
	depends on (USB_DWC_OTG_DUAL || USB_DWC_DEV_ONLY)

config DWC_LM_INTERFACE
	bool
	depends on USB_DWC_OTG
```
